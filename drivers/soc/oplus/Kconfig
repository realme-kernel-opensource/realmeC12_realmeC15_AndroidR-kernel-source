## drivers/soc/oplus/Kconfig
```kconfig
#ifdef OPLUS_FEATURE_TP_BASIC
#Renbing.Yao@BSP.TP.Init, 2020/06/18, Add for move device info
config OPPO_COMMON_SOFT
  bool "config oppo common software"
  select OPPO_ARCH_FILE
  help
        define this config to get project verion from sharemem.
        Maybe this value is from CDT or dynamic identify by hardware
        id.

config OPPO_DEVICE_IFNO
  bool "config oppo devinfo"
  select OPPO_ARCH_FILE
  help
        define this config to compile devinfo.c for device register

source "drivers/soc/oplus/device_info/Kconfig"
#endif /* OPLUS_FEATURE_TP_BASIC */
```

## drivers/soc/oplus/device_info/Kconfig
```kconfig
config OPPO_DEVICE_IFNO
  tristate "config oppo devinfo software"
  ---help---
    say Y to enable define this config to compile devinfo.c for device register
    Say M to enable define this config to compile devinfo.c for device register as module.
```

## sound/soc/codecs/audio/Kconfig
```kconfig
#
# oplus extend audio codec configuration
#

# Jun.Liang@MULTIMEDIA.AUDIODRIVER.SMARTPA, 2020/09/08, add for SIA PA ALGO
config SIA_PA_ALGO
	bool "Use SIA PA ALGO"
	default n

config SND_SOC_AW87339
	bool "Use AW87339 As PA"
	default n

#Yongzhi.Zhang@PSW.MM.AudioDriver.Codec, 2019/09/27, add for SIA PA ALGO
config HSKEY_BLOCK
	bool "Block hskey for 1s"
	default n

#sidong.Zhao@WT,2021/3/9, add aw87339 driver
config SND_SOC_AW87XXX
	tristate "SoC Audio for awinic AW87XXX Smart K PA"
	depends on I2C
	help
	This option enables support for AW87XXX Smart K PA.
```
